/*********************************************************************************************************
*
*   Author: Stefano Mercogliano <stefano.mercogliano@unina.it>
*   Description:
*       TBD
*
**********************************************************************************************************/

SECTIONS
{
    /************************************
    *      ___                          *
    *     / __| ___ __ _  _ _ _ ___     *
    *     \__ \/ -_) _| || | '_/ -_)    *
    *     |___/\___\__|\_,_|_| \___|    *
    *                                   *
    ************************************/

    /***************
    * Kernel Area  *
    ****************/

    ._umb_test :
    {
        KEEP(*(.text.umbra_test_0))
        KEEP(*(.text.umbra_test_1))
        KEEP(*(.text.umbra_test_2))
    } > _SECURE_KERNEL_TEXT_MEMORY_

    /****************************************************
    *      _  _             ___                         *
    *     | \| |___ _ _ ___/ __| ___ __ _  _ _ _ ___    *
    *     | .` / _ \ ' \___\__ \/ -_) _| || | '_/ -_)   *
    *     |_|\_\___/_||_|  |___/\___\__|\_,_|_| \___|   *
    *      / __|__ _| | |__ _| |__| |___                *
    *     | (__/ _` | | / _` | '_ \ / -_)               *
    *      \___\__,_|_|_\__,_|_.__/_\___|               *
    *                                                   *
    ****************************************************/

    .nsc : 
    {
        . = ALIGN(32);
        KEEP(*(.nsc));  
    } > _NSC_TEXT_MEMORY_
}